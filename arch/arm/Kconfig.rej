## arch/arm/Kconfig.rej
```kconfig
***************
*** 52,57 ****
  config GENERIC_GPIO
  	bool
  
  config ARCH_USES_GETTIMEOFFSET
  	bool
  	default n
--- 52,60 ----
  config GENERIC_GPIO
  	bool
  
+ config GENERIC_TIME_VSYSCALL
+ 	bool
+ 
  config ARCH_USES_GETTIMEOFFSET
  	bool
  	default n
***************
*** 1031,1036 ****
  	bool
  	select CLKSRC_MMIO
  
  source arch/arm/mm/Kconfig
  
  config IWMMXT
--- 1034,1047 ----
  	bool
  	select CLKSRC_MMIO
  
+ if IPIPE
+ config IPIPE_ARM_KUSER_TSC
+        bool
+        select GENERIC_TIME_VSYSCALL
+        select HAVE_IPIPE_HOSTRT
+        default y if ARCH_AT91 || ARM_TIMER_SP804 || ARCH_MXC || ARCH_OMAP || PLAT_PXA || PLAT_S3C24XX || ARCH_SA1100
+ endif
+ 
  source arch/arm/mm/Kconfig
  
  config IWMMXT
***************
*** 1430,1435 ****
  	  accounting to be spread across the timer interval, preventing a
  	  "thundering herd" at every timer tick.
  
  source kernel/Kconfig.preempt
  
  config HZ
--- 1441,1448 ----
  	  accounting to be spread across the timer interval, preventing a
  	  "thundering herd" at every timer tick.
  
+ source kernel/ipipe/Kconfig
+ 
  source kernel/Kconfig.preempt
  
  config HZ
***************
*** 2024,2029 ****
  	  Say Y to include support code for NEON, the ARMv7 Advanced SIMD
  	  Extension.
  
  endmenu
  
  menu "Userspace binary formats"
--- 2037,2046 ----
  	  Say Y to include support code for NEON, the ARMv7 Advanced SIMD
  	  Extension.
  
+ config VFP_3_2_BACKPORT
+        bool
+        default y if VFP
+ 
  endmenu
  
  menu "Userspace binary formats"
```

## arch/arm/mach-mx6/Kconfig.rej
```kconfig
--- arch/arm/mach-mx6/Kconfig
+++ arch/arm/mach-mx6/Kconfig
@@ -173,6 +173,10 @@
 	select IMX_HAVE_PLATFORM_IMX_ASRC
 	select IMX_HAVE_PLATFORM_FLEXCAN
 	select IMX_HAVE_PLATFORM_IMX_CAAM
+	select IMX_HAVE_PLATFORM_IMX_MIPI_DSI
+	select IMX_HAVE_PLATFORM_IMX_MIPI_CSI2
+	select IMX_HAVE_PLATFORM_IMX_DVFS
+	select IMX_HAVE_PLATFORM_PERFMON
 	help
 	  Include support for i.MX 6Quad SABRE Lite platform. This includes specific
 	  configurations for the board and its peripherals.
```

## arch/arm/plat-mxc/Kconfig.rej
```kconfig
--- arch/arm/plat-mxc/Kconfig
+++ arch/arm/plat-mxc/Kconfig
@@ -51,6 +51,7 @@
 config ARCH_MX6
 	bool "MX6-based"
 	select CPU_V7
+	select LOCAL_TIMERS if IPIPE && SMP
 	help
 	  This enable support for systems based on the Freescale i.MX 6 Series family
 
```

## arch/arm/plat-omap/Kconfig.rej
```kconfig
***************
*** 138,147 ****
         tristate "Export OMAP IOMMU internals in DebugFS"
         depends on OMAP_IOMMU && DEBUG_FS
         help
-          Select this to see extensive information about
-          the internal state of OMAP IOMMU in debugfs.
  
-          Say N unless you know you need this.
  
  config OMAP_IOMMU_IVA2
  	bool
--- 138,147 ----
         tristate "Export OMAP IOMMU internals in DebugFS"
         depends on OMAP_IOMMU && DEBUG_FS
         help
+ 	 Select this to see extensive information about
+ 	 the internal state of OMAP IOMMU in debugfs.
  
+ 	 Say N unless you know you need this.
  
  config OMAP_IOMMU_IVA2
  	bool
***************
*** 154,159 ****
  	  timer provides more intra-tick resolution than the 32KHz timer,
  	  but consumes more power.
  
  config OMAP_32K_TIMER
  	bool "Use 32KHz timer"
  	depends on ARCH_OMAP16XX || ARCH_OMAP2PLUS
--- 154,160 ----
  	  timer provides more intra-tick resolution than the 32KHz timer,
  	  but consumes more power.
  
+ if !IPIPE || SMP
  config OMAP_32K_TIMER
  	bool "Use 32KHz timer"
  	depends on ARCH_OMAP16XX || ARCH_OMAP2PLUS
***************
*** 164,169 ****
  	  support for no tick during idle. The 32KHz timer provides less
  	  intra-tick resolution than OMAP_MPU_TIMER. The 32KHz timer is
  	  currently only available for OMAP16XX, 24XX, 34XX and OMAP4.
  
  config OMAP3_L2_AUX_SECURE_SAVE_RESTORE
  	bool "OMAP3 HS/EMU save and restore for L2 AUX control register"
--- 165,171 ----
  	  support for no tick during idle. The 32KHz timer provides less
  	  intra-tick resolution than OMAP_MPU_TIMER. The 32KHz timer is
  	  currently only available for OMAP16XX, 24XX, 34XX and OMAP4.
+ endif
  
  config OMAP3_L2_AUX_SECURE_SAVE_RESTORE
  	bool "OMAP3 HS/EMU save and restore for L2 AUX control register"
```

## drivers/misc/Kconfig.rej
```kconfig
***************
*** 89,95 ****
  
  config ATMEL_TCB_CLKSRC
  	bool "TC Block Clocksource"
- 	depends on ATMEL_TCLIB
  	default y
  	help
  	  Select this to get a high precision clocksource based on a
--- 89,95 ----
  
  config ATMEL_TCB_CLKSRC
  	bool "TC Block Clocksource"
+ 	depends on ATMEL_TCLIB && !IPIPE
  	default y
  	help
  	  Select this to get a high precision clocksource based on a
***************
*** 364,377 ****
  	  will be called bh1780gli.
  
  config SENSORS_BH1770
-          tristate "BH1770GLC / SFH7770 combined ALS - Proximity sensor"
-          depends on I2C
-          ---help---
-            Say Y here if you want to build a driver for BH1770GLC (ROHM) or
  	   SFH7770 (Osram) combined ambient light and proximity sensor chip.
  
-            To compile this driver as a module, choose M here: the
-            module will be called bh1770glc. If unsure, say N here.
  
  config SENSORS_APDS990X
  	 tristate "APDS990X combined als and proximity sensors"
--- 364,377 ----
  	  will be called bh1780gli.
  
  config SENSORS_BH1770
+ 	 tristate "BH1770GLC / SFH7770 combined ALS - Proximity sensor"
+ 	 depends on I2C
+ 	 ---help---
+ 	   Say Y here if you want to build a driver for BH1770GLC (ROHM) or
  	   SFH7770 (Osram) combined ambient light and proximity sensor chip.
  
+ 	   To compile this driver as a module, choose M here: the
+ 	   module will be called bh1770glc. If unsure, say N here.
  
  config SENSORS_APDS990X
  	 tristate "APDS990X combined als and proximity sensors"
```

## init/Kconfig.rej
```kconfig
***************
*** 87,92 ****
  
  config LOCALVERSION
  	string "Local version - append to kernel release"
  	help
  	  Append an extra string to the end of your kernel version.
  	  This will show up when you type uname, for example.
--- 87,93 ----
  
  config LOCALVERSION
  	string "Local version - append to kernel release"
+ 	default "-ipipe"
  	help
  	  Append an extra string to the end of your kernel version.
  	  This will show up when you type uname, for example.
```

## lib/Kconfig.debug.rej
```kconfig
***************
*** 143,148 ****
  	  - Enable verbose reporting from modpost to help solving
  	    the section mismatches reported.
  
  config DEBUG_KERNEL
  	bool "Kernel debugging"
  	help
--- 143,150 ----
  	  - Enable verbose reporting from modpost to help solving
  	    the section mismatches reported.
  
+ source "kernel/ipipe/Kconfig.debug"
+ 
  config DEBUG_KERNEL
  	bool "Kernel debugging"
  	help
```
